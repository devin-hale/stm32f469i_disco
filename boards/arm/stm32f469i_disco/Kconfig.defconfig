## boards/arm/stm32f469i_disco/Kconfig.defconfig
```kconfig
# STM32F469I-DISCO board configuration

# Copyright (c) 2016 Linaro Limited.
# SPDX-License-Identifier: Apache-2.0

if BOARD_STM32F469I_DISCO

config BOARD
	default "stm32f469i_disco"

config SPI_STM32_INTERRUPT
	default y
	depends on SPI

config INPUT
	default y if LVGL

if DISPLAY


# MEMC needs to be enabled in order to store
# display buffer to external SDRAM connected to FMC
config MEMC
	default y

endif # DISPLAY


endif # BOARD_STM32F469I_DISCO
```
